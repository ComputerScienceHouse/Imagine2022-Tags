## main/Kconfig.projbuild
```kconfig
# put here your custom config value
menu "Main"
config TAG_NUM
    hex "tag number (last byte of address)"
    range 0x0 0xff
    default 0x0
endmenu
```

## sdkconfig.defaults
```kconfig
# Override some defaults so BT stack is enabled and
# Classic BT is enabled and BT_DRAM_RELEASE is disabled
CONFIG_BT_ENABLED=y
CONFIG_BTDM_CTRL_MODE_BLE_ONLY=y
CONFIG_BTDM_CTRL_MODE_BR_EDR_ONLY=n
CONFIG_BTDM_CTRL_MODE_BTDM=n
CONFIG_BT_CLASSIC_ENABLED=n
CONFIG_BT_A2DP_ENABLE=n
CONFIG_BT_BLE_ENABLED=y
```
